// SPDX-License-Identifier: BSD-3-Clause
/*
 * Copyright (c) 2020, AngeloGioacchino Del Regno
 *                     <angelogioacchino.delregno@somainline.org>
 */

/dts-v1/;

#include "msm8998-sony-xperia-yoshino.dtsi"

/ {
	model = "Sony Xperia XZ Premium";
	compatible = "sony,xperia-maple", "qcom,msm8998";
};
&vreg_l22a_2p85 {
	regulator-min-microvolt = <2700000>;
	regulator-max-microvolt = <2700000>;
};
